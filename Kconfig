## Kconfig
```kconfig
mainmenu "An example kbuild project"


# boolean example
config FFAST_MATH
    bool "Go fast with -ffast-math"


# string example
config WEBSOCKET_HOST
    string "Websocket host address"
    default "me.example.com"


# defconfig example
config DEFCONFIG
    string "defconfig path"
    default "configs/secure_defconfig"


# choice example
choice
    prompt "test() implementation"

    config TEST1
        bool "test 1"

    config TEST2
        bool "test 2"
endchoice
```

## configs/stage_defconfig
```kconfig
CONFIG_WEBSOCKET_HOST="stage.example.com"
CONFIG_DEFCONFIG="configs/stage_defconfig"
CONFIG_TEST2=y
```
